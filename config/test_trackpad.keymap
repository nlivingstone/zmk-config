/*
 * Copyright (c) 2020 The ZMK Contributors
 *
 * SPDX-License-Identifier: MIT
 */

/ {
	keymap {
		compatible = "zmk,keymap";

		default_layer {
			display-name = "Default Layer";
			bindings = <>;
		};
	};
};

